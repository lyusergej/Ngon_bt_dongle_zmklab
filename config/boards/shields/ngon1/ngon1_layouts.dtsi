#include <physical_layouts.dtsi>

/ {
    physical_layouts {
        default_keys {
            // Формат: x y w h
            // Единицы — условные (например, 0.1 мм), главное — пропорции
            keys = <
                // Строка 0
                  0   0   100 100
                100   0   100 100
                200   0   100 100
                300   0   100 100
                400   0   100 100
                500   0   100 100

                // Строка 1
                  0 100   100 100
                100 100   100 100
                200 100   100 100
                300 100   100 100
                400 100   100 100
                500 100   100 100

                // Строка 2
                  0 200   100 100
                100 200   100 100
                200 200   100 100
                300 200   100 100
                400 200   100 100
                500 200   100 100

                // Строка 3
                  0 300   100 100
                100 300   100 100
                200 300   100 100
                300 300   100 100
                400 300   100 100
                500 300   100 100
            >;
        };
    };
};