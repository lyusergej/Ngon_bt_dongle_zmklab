## config/west.yml
```yaml
manifest:
  remotes:
    - name: zmkfirmware
      url-base: https://github.com/zmkfirmware
  projects:
    - name: zmk
      remote: zmkfirmware
      revision: 8689cfd2a7d2d4f12a25b85ce0a9deface2db9cd
      import: app/west.yml
  self:
    path: config
```
