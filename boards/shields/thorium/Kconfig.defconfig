## boards/shields/thorium/Kconfig.defconfig
```kconfig
if SHIELD_NGONB_DONGLE

config ZMK_KEYBOARD_NAME
    default "ngonb"

config ZMK_SPLIT_ROLE_CENTRAL
    default y

config ZMK_SPLIT
    default y

config ZMK_SPLIT_BLE_CENTRAL_PERIPHERALS
    default 2

endif

if SHIELD_NGONB_LEFT || SHIELD_NGONB_RIGHT

config ZMK_SPLIT
    default y

endif
```

## boards/shields/thorium/Kconfig.shield
```kconfig
config SHIELD_NGONB_DONGLE
    def_bool $(shields_list_contains,ngonb_dongle)

config SHIELD_NGONB_LEFT
    def_bool $(shields_list_contains,ngonb_left)

config SHIELD_NGONB_RIGHT
    def_bool $(shields_list_contains,ngonb_right)
```

## config/boards/shields/ngon1/Kconfig.defconfig
```kconfig
if SHIELD_NGON1_LEFT

config ZMK_KEYBOARD_NAME
    default "Ngon1"

config ZMK_SPLIT_ROLE_CENTRAL
    default y

config ZMK_SPLIT
    default y

endif
```

## config/boards/shields/ngon1/Kconfig.shield
```kconfig
config SHIELD_NGON1_LEFT
    def_bool $(shields_list_contains,ngon1_left)

config SHIELD_NGON1_RIGHT
    def_bool $(shields_list_contains,ngon1_right)

config SHIELD_NGON1_DONGLE
    def_bool $(shields_list_contains,ngon1_dongle)
```
